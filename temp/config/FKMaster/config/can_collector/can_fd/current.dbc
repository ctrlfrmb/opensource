VERSION ""

NS_ :

BS_:

BU_:

BO_ 2147483904 CurrentFD_1: 64 Vector__XXX
 SG_ CurrentFD08 : 224|32@1- (1,0) [0|0] "uA" Vector__XXX
 SG_ CurrentFD07 : 192|32@1- (1,0) [0|0] "uA" Vector__XXX
 SG_ CurrentFD06 : 160|32@1- (1,0) [0|0] "uA" Vector__XXX
 SG_ CurrentFD05 : 128|32@1- (1,0) [0|0] "uA" Vector__XXX
 SG_ CurrentFD04 : 96|32@1- (1,0) [0|0] "uA" Vector__XXX
 SG_ CurrentFD03 : 64|32@1- (1,0) [0|0] "uA" Vector__XXX
 SG_ CurrentFD02 : 32|32@1- (1,0) [0|0] "uA" Vector__XXX
 SG_ CurrentFD01 : 0|32@1- (1,0) [0|0] "uA" Vector__XXX

BA_DEF_ BO_  "VFrameFormat" ENUM  "StandardCAN","ExtendedCAN","reserved","reserved","reserved","reserved","reserved","reserved","reserved","reserved","reserved","reserved","reserved","reserved","StandardCAN_FD","ExtendedCAN_FD";
BA_DEF_  "BusType" STRING ;
BA_DEF_DEF_  "VFrameFormat" "ExtendedCAN_FD";
BA_DEF_DEF_  "BusType" "CAN";
BA_ "BusType" "CAN FD";
