VERSION ""

NS_ :

BS_:

BU_:

BO_ 2147483904 TemperatureFD_1: 32 Vector__XXX
 SG_ TempFD16 : 240|16@1- (0.1,0) [0|0] "degC" Vector__XXX
 SG_ TempFD15 : 224|16@1- (0.1,0) [0|0] "degC" Vector__XXX
 SG_ TempFD14 : 208|16@1- (0.1,0) [0|0] "degC" Vector__XXX
 SG_ TempFD13 : 192|16@1- (0.1,0) [0|0] "degC" Vector__XXX
 SG_ TempFD12 : 176|16@1- (0.1,0) [0|0] "degC" Vector__XXX
 SG_ TempFD11 : 160|16@1- (0.1,0) [0|0] "degC" Vector__XXX
 SG_ TempFD10 : 144|16@1- (0.1,0) [0|0] "degC" Vector__XXX
 SG_ TempFD09 : 128|16@1- (0.1,0) [0|0] "degC" Vector__XXX
 SG_ TempFD08 : 112|16@1- (0.1,0) [0|0] "degC" Vector__XXX
 SG_ TempFD07 : 96|16@1- (0.1,0) [0|0] "degC" Vector__XXX
 SG_ TempFD06 : 80|16@1- (0.1,0) [0|0] "degC" Vector__XXX
 SG_ TempFD05 : 64|16@1- (0.1,0) [0|0] "degC" Vector__XXX
 SG_ TempFD04 : 48|16@1- (0.1,0) [0|0] "degC" Vector__XXX
 SG_ TempFD03 : 32|16@1- (0.1,0) [0|0] "degC" Vector__XXX
 SG_ TempFD02 : 16|16@1- (0.1,0) [0|0] "degC" Vector__XXX
 SG_ TempFD01 : 0|16@1- (0.1,0) [0|0] "degC" Vector__XXX

BA_DEF_ BO_  "VFrameFormat" ENUM  "StandardCAN","ExtendedCAN","reserved","reserved","reserved","reserved","reserved","reserved","reserved","reserved","reserved","reserved","reserved","reserved","StandardCAN_FD","ExtendedCAN_FD";
BA_DEF_  "BusType" STRING ;
BA_DEF_DEF_  "VFrameFormat" "ExtendedCAN_FD";
BA_DEF_DEF_  "BusType" "CAN";
BA_ "BusType" "CAN FD";
