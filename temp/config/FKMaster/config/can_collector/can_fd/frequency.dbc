VERSION ""

NS_ :

BS_:

BU_:

BO_ 2147483904 FrequencyFD_1: 32 Vector__XXX
 SG_ FrequencyFD16 : 240|16@1- (1,0) [0|0] "degC" Vector__XXX
 SG_ FrequencyFD15 : 224|16@1- (1,0) [0|0] "degC" Vector__XXX
 SG_ FrequencyFD14 : 208|16@1- (1,0) [0|0] "degC" Vector__XXX
 SG_ FrequencyFD13 : 192|16@1- (1,0) [0|0] "degC" Vector__XXX
 SG_ FrequencyFD12 : 176|16@1- (1,0) [0|0] "degC" Vector__XXX
 SG_ FrequencyFD11 : 160|16@1- (1,0) [0|0] "degC" Vector__XXX
 SG_ FrequencyFD10 : 144|16@1- (1,0) [0|0] "degC" Vector__XXX
 SG_ FrequencyFD09 : 128|16@1- (1,0) [0|0] "degC" Vector__XXX
 SG_ FrequencyFD08 : 112|16@1- (1,0) [0|0] "degC" Vector__XXX
 SG_ FrequencyFD07 : 96|16@1- (1,0) [0|0] "degC" Vector__XXX
 SG_ FrequencyFD06 : 80|16@1- (1,0) [0|0] "degC" Vector__XXX
 SG_ FrequencyFD05 : 64|16@1- (1,0) [0|0] "degC" Vector__XXX
 SG_ FrequencyFD04 : 48|16@1- (1,0) [0|0] "degC" Vector__XXX
 SG_ FrequencyFD03 : 32|16@1- (1,0) [0|0] "degC" Vector__XXX
 SG_ FrequencyFD02 : 16|16@1- (1,0) [0|0] "degC" Vector__XXX
 SG_ FrequencyFD01 : 0|16@1- (1,0) [0|0] "degC" Vector__XXX

BA_DEF_ BO_  "VFrameFormat" ENUM  "StandardCAN","ExtendedCAN","reserved","reserved","reserved","reserved","reserved","reserved","reserved","reserved","reserved","reserved","reserved","reserved","StandardCAN_FD","ExtendedCAN_FD";
BA_DEF_  "BusType" STRING ;
BA_DEF_DEF_  "VFrameFormat" "ExtendedCAN_FD";
BA_DEF_DEF_  "BusType" "CAN";
BA_ "BusType" "CAN FD";
