VERSION ""

NS_ :

BS_:

BU_:

BO_ 2147484161 VoltageFD_1: 64 Vector__XXX
 SG_ VoltageFD16 : 480|32@1- (1,0) [0|0] "uV" Vector__XXX
 SG_ VoltageFD15 : 448|32@1- (1,0) [0|0] "uV" Vector__XXX
 SG_ VoltageFD14 : 416|32@1- (1,0) [0|0] "uV" Vector__XXX
 SG_ VoltageFD13 : 384|32@1- (1,0) [0|0] "uV" Vector__XXX
 SG_ VoltageFD12 : 352|32@1- (1,0) [0|0] "uV" Vector__XXX
 SG_ VoltageFD11 : 320|32@1- (1,0) [0|0] "uV" Vector__XXX
 SG_ VoltageFD10 : 288|32@1- (1,0) [0|0] "uV" Vector__XXX
 SG_ VoltageFD09 : 256|32@1- (1,0) [0|0] "uV" Vector__XXX
 SG_ VoltageFD08 : 224|32@1- (1,0) [0|0] "uV" Vector__XXX
 SG_ VoltageFD07 : 192|32@1- (1,0) [0|0] "uV" Vector__XXX
 SG_ VoltageFD06 : 160|32@1- (1,0) [0|0] "uV" Vector__XXX
 SG_ VoltageFD05 : 128|32@1- (1,0) [0|0] "uV" Vector__XXX
 SG_ VoltageFD04 : 96|32@1- (1,0) [0|0] "uV" Vector__XXX
 SG_ VoltageFD03 : 64|32@1- (1,0) [0|0] "uV" Vector__XXX
 SG_ VoltageFD02 : 32|32@1- (1,0) [0|0] "uV" Vector__XXX
 SG_ VoltageFD01 : 0|32@1- (1,0) [0|0] "uV" Vector__XXX

BA_DEF_ BO_  "VFrameFormat" ENUM  "StandardCAN","ExtendedCAN","reserved","reserved","reserved","reserved","reserved","reserved","reserved","reserved","reserved","reserved","reserved","reserved","StandardCAN_FD","ExtendedCAN_FD";
BA_DEF_  "BusType" STRING ;
BA_DEF_DEF_  "VFrameFormat" "ExtendedCAN_FD";
BA_DEF_DEF_  "BusType" "CAN";
BA_ "BusType" "CAN FD";
