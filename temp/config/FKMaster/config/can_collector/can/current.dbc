VERSION ""

NS_ :

BS_:

BU_:

BO_ 256 Current_1: 8 Vector__XXX
 SG_ Current02 : 32|32@1- (1,0) [0|0] "uA" Vector__XXX
 SG_ Current01 : 0|32@1- (1,0) [0|0] "uA" Vector__XXX

BO_ 257 Current_2: 8 Vector__XXX
 SG_ Current04 : 32|32@1- (1,0) [0|0] "uA" Vector__XXX
 SG_ Current03 : 0|32@1- (1,0) [0|0] "uA" Vector__XXX

BO_ 258 Current_3: 8 Vector__XXX
 SG_ Current06 : 32|32@1- (1,0) [0|0] "uA" Vector__XXX
 SG_ Current05 : 0|32@1- (1,0) [0|0] "uA" Vector__XXX

BO_ 259 Current_4: 8 Vector__XXX
 SG_ Current08 : 32|32@1- (1,0) [0|0] "uA" Vector__XXX
 SG_ Current07 : 0|32@1- (1,0) [0|0] "uA" Vector__XXX

BA_DEF_  "BusType" STRING ;
BA_DEF_DEF_  "BusType" "CAN";
