VERSION ""

NS_ :

BS_:

BU_:

BO_ 256 Voltage_1: 8 Vector__XXX
 SG_ Voltage02 : 32|32@1- (1,0) [0|0] "uA" Vector__XXX
 SG_ Voltage01 : 0|32@1- (1,0) [0|0] "uA" Vector__XXX

BO_ 257 Voltage_2: 8 Vector__XXX
 SG_ Voltage04 : 32|32@1- (1,0) [0|0] "uA" Vector__XXX
 SG_ Voltage03 : 0|32@1- (1,0) [0|0] "uA" Vector__XXX

BO_ 258 Voltage_3: 8 Vector__XXX
 SG_ Voltage06 : 32|32@1- (1,0) [0|0] "uA" Vector__XXX
 SG_ Voltage05 : 0|32@1- (1,0) [0|0] "uA" Vector__XXX

BO_ 259 Voltage_4: 8 Vector__XXX
 SG_ Voltage08 : 32|32@1- (1,0) [0|0] "uA" Vector__XXX
 SG_ Voltage07 : 0|32@1- (1,0) [0|0] "uA" Vector__XXX

BO_ 260 Voltage_5: 8 Vector__XXX
 SG_ Voltage10 : 32|32@1- (1,0) [0|0] "uA" Vector__XXX
 SG_ Voltage09 : 0|32@1- (1,0) [0|0] "uA" Vector__XXX

BO_ 261 Voltage_6: 8 Vector__XXX
 SG_ Voltage12 : 32|32@1- (1,0) [0|0] "uA" Vector__XXX
 SG_ Voltage11 : 0|32@1- (1,0) [0|0] "uA" Vector__XXX

BO_ 262 Current_7: 8 Vector__XXX
 SG_ Voltage14 : 32|32@1- (1,0) [0|0] "uA" Vector__XXX
 SG_ Voltage13 : 0|32@1- (1,0) [0|0] "uA" Vector__XXX

BO_ 263 Current_8: 8 Vector__XXX
 SG_ Voltage16 : 32|32@1- (1,0) [0|0] "uA" Vector__XXX
 SG_ Voltage15 : 0|32@1- (1,0) [0|0] "uA" Vector__XXX

BA_DEF_  "BusType" STRING ;
BA_DEF_DEF_  "BusType" "CAN";
